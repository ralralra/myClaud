// ============================================================================
//   서보 하나씩 움직여 보기 — 관절 확인용 코드
//   싸이피아 6자유도 로봇팔 · www.scipia.co.kr
// ----------------------------------------------------------------------------
//   [무엇을 하나?]  1번 → 2번 → … → 6번 서보를 '한 개씩' 천천히 움직인다.
//   [왜 쓰나?]      어느 서보가 어느 관절(부위)인지 눈으로 확인 →
//                   활동지 '관절 매핑표'를 채울 때 사용한다.
//   [보는 법]       시리얼 모니터(9600 baud)를 열면 "지금 N번 서보"가 표시된다.
// ============================================================================

#include <Servo.h>                 // 서보 도구상자

const int SERVOS = 6;              // 서보(관절) 개수
int  PIN[SERVOS] = { 2, 3, 9, 8, 4, 5 };   // 각 서보가 꽂힌 핀 번호
int  MINA[SERVOS] = { 0, 0, 0, 0, 0, 0 };  // 각 서보 최소 각도
int  MAXA[SERVOS] = { 180, 180, 180, 180, 180, 90 }; // 최대(그리퍼=6번만 90)
int  HOME[SERVOS] = { 90, 90, 90, 90, 90, 45 };      // 안전한 시작 각도
Servo myservo[SERVOS];            // 서보 6개(실제 모터)

void setup() {
  Serial.begin(9600);             // 컴퓨터와 통신 시작(어느 서보인지 표시용)

  // 서보 6개를 각자의 핀에 연결하고, 안전한 시작 자세로 보낸다
  for (int i = 0; i < SERVOS; i++) {
    myservo[i].attach(PIN[i]);
    myservo[i].write(HOME[i]);
  }
  delay(1000);                    // 자세가 잡힐 때까지 잠깐 대기
  Serial.println("서보 하나씩 확인 시작! 어느 관절이 움직이는지 보세요.");
}

void loop() {
  // 서보를 0번부터 5번까지 '한 개씩' 차례로 움직인다
  for (int i = 0; i < SERVOS; i++) {

    Serial.print(">> 지금 ");      // 지금 움직이는 서보 번호를 알려준다
    Serial.print(i + 1);          // 사람이 세는 번호(1~6)로 표시
    Serial.println("번 서보를 움직입니다");

    sweepOne(i);                  // ↓ 아래에서 만든 '한 개 왕복' 함수 실행

    myservo[i].write(HOME[i]);    // 확인이 끝나면 원래 자세로 되돌려 놓기
    delay(1000);                  // 다음 서보로 넘어가기 전 1초 쉬기(기록할 시간)
  }

  Serial.println("=== 한 바퀴 끝! 다시 1번부터 반복합니다 ===");
  delay(1500);
}

// ----------------------------------------------------------------------------
//  [함수] sweepOne(i) : i번 서보 하나만 최소→최대→최소로 천천히 왕복시킨다.
//         (그리퍼처럼 가동범위가 좁은 서보도 MINA/MAXA 덕분에 안전하다)
// ----------------------------------------------------------------------------
void sweepOne(int i) {
  // 최소 각도 → 최대 각도 (1도씩 증가)
  for (int a = HOME[i]; a <= MAXA[i]; a++) {
    myservo[i].write(a);
    delay(100);                    // 숫자를 키우면 더 천천히 움직인다
  }
  // 최대 각도 → 최소 각도 (1도씩 감소)
  for (int a = MAXA[i]; a >= MINA[i]; a--) {
    myservo[i].write(a);
    delay(100);
  }
    for (int a = MINA[i]; a >= HOME[i]; a--) {
    myservo[i].write(a);
    delay(100);
  }
}
