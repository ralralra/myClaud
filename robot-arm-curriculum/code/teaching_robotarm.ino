// ============================================================================
//   아두이노 6자유도 로봇팔 — 교육용 코드 (구획 설명 + 함수 만드는 곳)
// ----------------------------------------------------------------------------
//   [초보자 안내] 아두이노 코드는 크게 3덩어리로 되어 있다.
//     ① 준비 구역   : 라이브러리·변수(로봇팔이 쓸 재료 준비)
//     ② setup()     : 딱 한 번 실행 — 핀·각도 설정
//     ③ loop()      : 계속 반복 — 조이스틱을 읽어 로봇팔을 움직임
//   그리고 맨 아래 ④ 함수 구역 에 "반복 동작"을 함수로 만들어 둔다.
// ============================================================================


// ============================================================================
//  ① 준비 구역 — 재료 꺼내기
//     · 라이브러리 = 서보모터를 쉽게 다루는 도구상자
//     · 배열[SERVOS] = 6개 서보의 정보를 한 줄로 묶어 관리
// ============================================================================
#include <Servo.h>            // 서보모터 제어 도구상자 불러오기

const int SERVOS = 6;         // 서보(관절) 개수 = 6
int  PIN[SERVOS];             // 각 서보가 꽂힌 핀 번호
int  MIN[SERVOS], MAX[SERVOS];// 각 서보의 최소/최대 각도 (안전 범위)
int  INITANGLE[SERVOS];       // 전원을 켤 때의 시작 각도
int  ANA[SERVOS];             // 각 서보를 조종하는 조이스틱(아날로그) 번호
int  currentAngle[SERVOS];    // 지금 각도
int  value[SERVOS];           // 조이스틱에서 읽은 값(0~1023)
Servo myservo[SERVOS];        // 서보 6개 (실제 모터)


// ============================================================================
//  ② setup() — 딱 한 번 실행되는 "설정" 구역
//     각 서보의 핀 / 최소각 / 최대각 / 시작각 / 조이스틱 번호를 정한다.
// ============================================================================
void setup() {
  Serial.begin(9600);         // (선택) 시리얼 통신 시작 — 6단계에서 각도 출력에 사용

  //           핀       최소   최대    시작각   조이스틱
  setServo(0,  2,   0,  180,   90,   0);   // 1번 서보
  setServo(1,  3,   0,  180,   90,   1);   // 2번 서보
  setServo(2,  9,   0,  180,   90,   2);   // 3번 서보
  setServo(3,  8,   0,  180,   90,   3);   // 4번 서보
  setServo(4,  4,   0,  180,   90,   4);   // 5번 서보
  setServo(5,  5,   0,   90,   45,   5);   // 6번 서보(그리퍼): 열림 0° / 닫힘 90°

  // 서보를 실제로 연결하고 시작 각도로 보낸다
  for (int i = 0; i < SERVOS; i++) {
    myservo[i].attach(PIN[i]);
    myservo[i].write(INITANGLE[i]);
    currentAngle[i] = INITANGLE[i];
  }
}


// ============================================================================
//  ③ loop() — 계속 반복되는 "동작" 구역  (로봇팔의 심장)
//     핵심 한 줄:  조이스틱을 읽어서 → 각도를 +1/−1 → 서보에 쓴다.
// ============================================================================
void loop() {
  delay(50);                  // 속도 조절(숫자가 작을수록 빠름)

  for (int i = 0; i < SERVOS; i++) {
    value[i] = analogRead(ANA[i]);         // 조이스틱 값 읽기 (0~1023)
    currentAngle[i] = myservo[i].read();   // 현재 각도 확인

    if (value[i] > 612) {                  // 조이스틱을 한쪽으로 밀면 → 각도 +
      if (currentAngle[i] < MAX[i]) currentAngle[i]++;
      myservo[i].write(currentAngle[i]);
    }
    else if (value[i] < 412) {             // 반대로 밀면 → 각도 −
      if (currentAngle[i] > MIN[i]) currentAngle[i]--;
      myservo[i].write(currentAngle[i]);
    }
    // 412~612 사이(가운데)는 '멈춤' — 조이스틱 중립 구간(데드존)
  }

  // (선택) 시리얼 모니터에 'p'를 입력하면 현재 6축 각도를 출력한다 → 8단계 포즈 기록용
  if (Serial.available() > 0 && (Serial.read() == 'p')) printAngles();
}


// ============================================================================
//  ④ 함수 구역 — "여기에" 함수를 만든다  (loop() 바깥, 파일 아래쪽)
// ----------------------------------------------------------------------------
//  함수란? 자주 쓰는 동작 덩어리에 '이름'을 붙여 둔 것.
//  만드는 법:   반환형(void)  이름()  {  할 일  }
//  쓰는 법  :   loop()나 다른 함수 안에서  이름();  이라고 부르면 실행된다.
// ============================================================================

// [설정 도우미] setup을 짧게 만들려고 미리 만들어 둔 함수 (매개변수 6개를 받음)
void setServo(int i, int pin, int mn, int mx, int init, int ana) {
  PIN[i] = pin;  MIN[i] = mn;  MAX[i] = mx;  INITANGLE[i] = init;  ANA[i] = ana;
}

// [예시 함수 1] 그리퍼 열기 / 닫기 — 손만 제어 (그리퍼 = 6번, 인덱스 5)
void gripperOpen()  { myservo[5].write(0);  delay(400); }   // 열림 0°
void gripperClose() { myservo[5].write(90); delay(400); }   // 닫힘 90°

// [예시 함수 2] 홈 자세로 보내기 — 모든 서보를 시작 각도로
void goHome() {
  for (int i = 0; i < SERVOS; i++) myservo[i].write(INITANGLE[i]);
  delay(500);
}

// [예시 함수 3] 현재 각도 출력 — 시리얼 모니터로 6축 각도를 한 줄에 (8단계에서 사용)
void printAngles() {
  Serial.print("현재 각도 -> { ");
  for (int i = 0; i < SERVOS; i++) { Serial.print(myservo[i].read()); if (i < 5) Serial.print(", "); }
  Serial.println(" }");
}

// ----------------------------------------------------------------------------
//  ★ 학생이 만들 함수 자리 (아래 빈 함수를 채워 보자!)
//    예) 손 흔들기: 특정 각도로 보냈다가 되돌아오기
// ----------------------------------------------------------------------------
void myMove() {
  // 예시:  myservo[0].write(60); delay(400); myservo[0].write(120); delay(400);
  //        (여기에 나만의 동작을 작성)
}

//  [자동화 맛보기]  위 함수들을 '순서대로' 부르면 자동 동작이 된다.
//  loop() 안에서 버튼(디지털 7번)을 눌렀을 때 아래처럼 부르면 자동 Pick & Place:
//     gripperOpen();  ... 팔 이동 ...  gripperClose();  ... 이동 ...  gripperOpen();  goHome();
